// MultiFirm v1 fixed layout, slot metadata record and naming rules.
//
// Independent of ESP-IDF and valid C++11 (Arduino-ESP32 2.x builds with -std=gnu++11);
// the native tests build it as C++17.
// Keep in sync with tools/layout.py (tests/test_multifirm.py compares the constants,
// tests/test_layout.cpp reads records generated by Python).
#pragma once

#include <cstddef>
#include <cstdint>
#include <cstring>

namespace multifirm {
namespace layout {

static constexpr uint32_t kFlashSize = 0x1000000;
static constexpr uint32_t kPartitionTableOffset = 0x8000;
static constexpr uint32_t kPartitionTableSize = 0xC00;
static constexpr uint32_t kSectorSize = 0x1000;

static constexpr uint8_t kTypeApp = 0x00;
static constexpr uint8_t kTypeData = 0x01;
static constexpr uint8_t kSubtypeMultifirmMeta = 0x40;

struct PartitionDef {
    const char* label;
    uint8_t type;
    uint8_t subtype;
    uint32_t offset;
    uint32_t size;
};

// Table order matters: Arduino erases the first data/nvs partition, so `nvs` stays
// before `multifirm_nvs`.
static constexpr PartitionDef kPartitions[] = {
    {"nvs", kTypeData, 0x02, 0x9000, 0x10000},
    {"otadata", kTypeData, 0x00, 0x19000, 0x2000},
    {"phy_init", kTypeData, 0x01, 0x1B000, 0x1000},
    {"multifirm_meta", kTypeData, kSubtypeMultifirmMeta, 0x1C000, 0x4000},
    {"ota_0", kTypeApp, 0x10, 0x20000, 0x400000},
    {"ota_1", kTypeApp, 0x11, 0x420000, 0x1F0000},
    {"ota_2", kTypeApp, 0x12, 0x610000, 0x1F0000},
    {"ota_3", kTypeApp, 0x13, 0x800000, 0x1F0000},
    {"multifirm_nvs", kTypeData, 0x02, 0x9F0000, 0x10000},
    {"storage", kTypeData, 0x81, 0xA00000, 0x400000},
    {"coredump", kTypeData, 0x03, 0xE00000, 0x10000},
};
static constexpr size_t kPartitionCount = sizeof(kPartitions) / sizeof(kPartitions[0]);

static constexpr uint32_t kHostOffset = 0x20000;
static constexpr uint32_t kHostMaxSize = 0x400000;
static constexpr int kGuestSlotCount = 3;
static constexpr uint32_t kGuestMaxSize = 0x1F0000;
static constexpr uint32_t kMetaOffset = 0x1C000;
static constexpr uint32_t kMetaSize = 0x4000;
static constexpr uint32_t kMetaReservedOffset = kMetaOffset + 3 * kSectorSize;

inline const PartitionDef* findPartition(const char* label) {
    for (const auto& p : kPartitions) {
        if (std::strcmp(p.label, label) == 0) return &p;
    }
    return nullptr;
}

// slot: 1..3. Returns 0 for an invalid slot.
constexpr uint32_t guestSlotOffset(int slot) {
    return (slot >= 1 && slot <= kGuestSlotCount) ? kPartitions[4 + slot].offset : 0;
}

constexpr uint32_t metaSectorOffset(int slot) {
    return (slot >= 1 && slot <= kGuestSlotCount) ? kMetaOffset + static_cast<uint32_t>(slot - 1) * kSectorSize : 0;
}

// ------------------------------------------------------------------ CRC

// CRC-32/ISO-HDLC (same as zlib.crc32). "123456789" -> 0xCBF43926.
inline uint32_t crc32(const uint8_t* data, size_t length, uint32_t crc = 0) {
    crc = ~crc;
    for (size_t i = 0; i < length; ++i) {
        crc ^= data[i];
        for (int bit = 0; bit < 8; ++bit) {
            crc = (crc >> 1) ^ (0xEDB88320u & (0u - (crc & 1u)));
        }
    }
    return ~crc;
}

// ------------------------------------------------------------------ metadata record

static constexpr uint32_t kMetaMagic = 0x4D52464D;  // "MFRM"
static constexpr uint16_t kMetaVersion = 1;
static constexpr uint16_t kMetaLength = 0x74;
static constexpr size_t kMetaRecordSize = 0x78;
static constexpr size_t kNameFieldSize = 32;
static constexpr size_t kNameMaxBytes = 31;

enum class MetaError {
    Ok,
    ShortRead,
    Empty,
    BadMagic,
    UnknownVersion,
    BadLength,
    CrcMismatch,
    NameNotTerminated,
    NamePaddingNotZero,
    NameInvalidUtf8,
    NameEmpty,
    NameControlChar,
    ImageSizeOutOfRange,
};

// Same strings as the Python reason codes.
inline const char* metaErrorName(MetaError e) {
    switch (e) {
        case MetaError::Ok: return "ok";
        case MetaError::ShortRead: return "short_read";
        case MetaError::Empty: return "empty";
        case MetaError::BadMagic: return "bad_magic";
        case MetaError::UnknownVersion: return "unknown_version";
        case MetaError::BadLength: return "bad_length";
        case MetaError::CrcMismatch: return "crc_mismatch";
        case MetaError::NameNotTerminated: return "name_not_terminated";
        case MetaError::NamePaddingNotZero: return "name_padding_not_zero";
        case MetaError::NameInvalidUtf8: return "name_invalid_utf8";
        case MetaError::NameEmpty: return "name_empty";
        case MetaError::NameControlChar: return "name_control_char";
        case MetaError::ImageSizeOutOfRange: return "image_size_out_of_range";
    }
    return "?";
}

struct MetaRecord {
    char name[kNameFieldSize];  // NUL-terminated UTF-8
    uint32_t image_size;
    uint8_t elf_sha256[32];
    uint8_t app_digest[32];
    uint64_t installed_at;
};

namespace detail {
inline uint16_t le16(const uint8_t* p) { return static_cast<uint16_t>(p[0] | (p[1] << 8)); }
inline uint32_t le32(const uint8_t* p) {
    return static_cast<uint32_t>(p[0]) | (static_cast<uint32_t>(p[1]) << 8) |
           (static_cast<uint32_t>(p[2]) << 16) | (static_cast<uint32_t>(p[3]) << 24);
}
inline uint64_t le64(const uint8_t* p) {
    return static_cast<uint64_t>(le32(p)) | (static_cast<uint64_t>(le32(p + 4)) << 32);
}
}  // namespace detail

// Strict UTF-8 (rejects overlong forms, surrogates and > U+10FFFF) without control
// characters (C0, DEL, C1), matching Python's unicodedata category "Cc".
inline MetaError validateName(const uint8_t* s, size_t n) {
    if (n == 0) return MetaError::NameEmpty;
    size_t i = 0;
    while (i < n) {
        uint32_t cp;
        uint8_t c = s[i];
        size_t extra;
        uint32_t min;
        if (c < 0x80) {
            cp = c; extra = 0; min = 0;
        } else if ((c & 0xE0) == 0xC0) {
            cp = c & 0x1F; extra = 1; min = 0x80;
        } else if ((c & 0xF0) == 0xE0) {
            cp = c & 0x0F; extra = 2; min = 0x800;
        } else if ((c & 0xF8) == 0xF0) {
            cp = c & 0x07; extra = 3; min = 0x10000;
        } else {
            return MetaError::NameInvalidUtf8;
        }
        if (extra > n - 1 - i) return MetaError::NameInvalidUtf8;  // truncated sequence
        for (size_t k = 1; k <= extra; ++k) {
            uint8_t cc = s[i + k];
            if ((cc & 0xC0) != 0x80) return MetaError::NameInvalidUtf8;
            cp = (cp << 6) | (cc & 0x3F);
        }
        if (cp < min || cp > 0x10FFFF || (cp >= 0xD800 && cp <= 0xDFFF)) return MetaError::NameInvalidUtf8;
        if (cp < 0x20 || (cp >= 0x7F && cp <= 0x9F)) return MetaError::NameControlChar;
        i += extra + 1;
    }
    return MetaError::Ok;
}

inline MetaError validateNameField(const uint8_t* field) {
    size_t nul = kNameFieldSize;
    for (size_t i = 0; i < kNameFieldSize; ++i) {
        if (field[i] == 0) { nul = i; break; }
    }
    if (nul == kNameFieldSize) return MetaError::NameNotTerminated;
    for (size_t i = nul; i < kNameFieldSize; ++i) {
        if (field[i] != 0) return MetaError::NamePaddingNotZero;
    }
    if (nul == 0) return MetaError::NameEmpty;
    return validateName(field, nul);
}

// Structural check of a metadata sector (steps 1-2 of the shared rule). Matching the
// record against a verified image (image_size, app_digest, elf_sha256) is separate.
inline MetaError decodeMeta(const uint8_t* data, size_t length, uint32_t capacity, MetaRecord& out) {
    if (length < kMetaRecordSize) return MetaError::ShortRead;
    bool erased = true;
    for (size_t i = 0; i < kMetaRecordSize; ++i) {
        if (data[i] != 0xFF) { erased = false; break; }
    }
    if (erased) return MetaError::Empty;
    if (detail::le32(data) != kMetaMagic) return MetaError::BadMagic;
    if (detail::le16(data + 4) != kMetaVersion) return MetaError::UnknownVersion;
    if (detail::le16(data + 6) != kMetaLength) return MetaError::BadLength;
    if (crc32(data, kMetaLength) != detail::le32(data + kMetaLength)) return MetaError::CrcMismatch;
    const MetaError name = validateNameField(data + 0x08);
    if (name != MetaError::Ok) return name;
    const uint32_t image_size = detail::le32(data + 0x28);
    if (image_size == 0 || image_size > capacity) return MetaError::ImageSizeOutOfRange;
    std::memcpy(out.name, data + 0x08, kNameFieldSize);
    out.image_size = image_size;
    std::memcpy(out.elf_sha256, data + 0x2C, 32);
    std::memcpy(out.app_digest, data + 0x4C, 32);
    out.installed_at = detail::le64(data + 0x6C);
    return MetaError::Ok;
}

// ------------------------------------------------------------------ display names

inline bool isDefaultProjectName(const char* name) {
    static constexpr const char* kDefaults[] = {"firmware", "arduino-lib-builder", "app-template"};
    if (name == nullptr || name[0] == '\0') return true;
    for (const char* d : kDefaults) {
        if (std::strcmp(name, d) == 0) return true;
    }
    return false;
}

// project_name from esp_app_desc_t (32 bytes, may lack a terminator).
inline bool isUsableProjectName(const char* project_name, size_t field_size = kNameFieldSize) {
    if (project_name == nullptr) return false;
    size_t n = 0;
    while (n < field_size && project_name[n] != '\0') ++n;
    if (n == 0 || n > kNameMaxBytes) return false;
    char buf[kNameFieldSize] = {};
    std::memcpy(buf, project_name, n);
    if (isDefaultProjectName(buf)) return false;
    return validateName(reinterpret_cast<const uint8_t*>(buf), n) == MetaError::Ok;
}

}  // namespace layout
}  // namespace multifirm
